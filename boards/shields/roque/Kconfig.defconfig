## boards/shields/roque/Kconfig.defconfig
```kconfig
if SHIELD_ROQUE_LEFT

config ZMK_KEYBOARD_NAME
    default "Roque"

config ZMK_SPLIT_ROLE_CENTRAL
    default y

endif

if SHIELD_ROQUE_LEFT || SHIELD_ROQUE_RIGHT

config ZMK_SPLIT
    default y

endif

if ZMK_BACKLIGHT

config PWM
    default y

config LED_PWM
    default y

endif # ZMK_BACKLIGHT
```

## boards/shields/roque/Kconfig.shield
```kconfig
config SHIELD_ROQUE_LEFT
    def_bool $(shields_list_contains,roque_left)

config SHIELD_ROQUE_RIGHT
    def_bool $(shields_list_contains,roque_right)
```

## config/west.yml
```yaml
manifest:
  remotes:
    - name: zmkfirmware
      url-base: https://github.com/zmkfirmware
    - name: elpekenin
      url-base: https://github.com/elpekenin
    - name: MickiusMousius
      url-base: https://github.com/MickiusMousius
    - name: m165437
      url-base: https://github.com/M165437
    # Used only by the Roque nice!view targets in build.yaml.
    - name: infely
      url-base: https://github.com/infely

  projects:
    - name: zmk
      import: app/west.yml
      remote: zmkfirmware
      revision: f9be3ed9c08b35b1b86df24c0f04913f3b5e50f5

    - name: zmk-userspace
      remote: elpekenin
      revision: fcf2d9c7a9820e9447edfa5b23cd00538a611c8e

    - name: zmk-ls0xxvcom-driver
      remote: MickiusMousius
      revision: main

    - name: zmk-patch-batterylevel
      remote: MickiusMousius
      revision: main

    - name: zmk-patch-ec11
      remote: MickiusMousius
      revision: main

    - name: nice-view-gem
      remote: m165437
      revision: v0.3.0

    # Infely display: selected only by the two Roque build targets.
    - name: nice-view-battery
      remote: infely
      revision: main

  self:
    path: config
```
